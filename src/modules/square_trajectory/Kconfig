## src/modules/square_trajectory/Kconfig
```kconfig
menuconfig MODULES_SQUARE_TRAJECTORY
	bool "square_trajectory"
	default n
	---help---
		Enable square trajectory test module.
		Flies a 1m x 1m square at 1m altitude with yaw rotation.
```

## src/modules/trajectory_test/Kconfig
```kconfig
menuconfig MODULES_TRAJECTORY_TEST
	bool "trajectory_test"
	default n
	---help---
		Enable trajectory test runner module.
		Flies predefined trajectories (square, circle, etc.) using OFFBOARD mode.
		Usage: trajectory_test start <name>
```
